# MU3E_AVSTHIT0CH2CNTR_CTRL register map
Vendor: Mu3e; Series: MU3E_FPGA_IP; File version: 1.0.0
CMSIS-SVD description of the avsthit0ch2cntr_ctrl avmm_rst_interval aperture.
Registers are 32-bit, read-write, reset 0x0 unless marked. A register's access mark holds for its fields unless they carry their own. Offsets are from the block's base; lines under a group give offsets from that group; [hi:lo] are bit positions; {n}, {i} and the like mark numbered series; 'fields as' and 'values as' point back to an identical list; <NAME> marks a mode.

## Memory map
0x00000000 AVSTHIT0CH2CNTR_CTRL size 0x4 — Relative single-word control aperture for the channel-counter reset interval.

## AVSTHIT0CH2CNTR_CTRL — Relative single-word control aperture for the channel-counter reset interval.
Base 0x00000000
0x00 RESET_INTERVAL — Runtime reset-interval control word for the channel counter fabric.
  [31:0] value — Raw interval configuration word.
